## firmware/main/Kconfig.projbuild
```kconfig
menu "BlitzerdeDsp"

    config BDSP_ENABLE_DISPLAY
        bool "Bring up the display + LVGL UI"
        default y
        help
            Phase B+. When off, the firmware is a board smoke test only
            (I2C scan, heap report, BOOT button).

    config BDSP_ENABLE_BLE
        bool "Build the NimBLE transport"
        default y
        help
            Phase D. Pulls in the Bluetooth stack. When off, the UI runs purely
            from the MockTransport demo timeline.

    config BDSP_ENABLE_AUDIO
        bool "Build the ES8311 audio output"
        default y
        help
            Warning tones + composed voice phrases on the board speaker. Pulls in
            esp_codec_dev + the I2S driver. When off, cues are decoded but silent.

    config BDSP_FEATURE_SPEEDCAM
        bool "Compile speed-camera (Blitzer) support"
        default y
        help
            When disabled, the speed-camera HazardType range, its icons and the
            "Blitzer" column of the report screen are removed from the build, and
            incoming speed-camera hazards are suppressed. For §23 (1b) StVO builds.

    config BDSP_DEMO_LONGPRESS_MS
        int "BOOT long-press (ms) to toggle demo mode"
        default 1500

    config BDSP_STATE_WATCHDOG_S
        int "Seconds without a DisplayState before the link is treated as stale"
        default 8

endmenu
```
